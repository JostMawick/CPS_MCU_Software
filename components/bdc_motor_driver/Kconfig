## components/bdc_motor_driver/Kconfig
```kconfig
menu "BDC Motor Driver Configuration"

    config BDC_MOTOR_PWM_GPIO_A
        int "PWM A GPIO"
        default 13
        help
            GPIO number for PWM A output.

    config BDC_MOTOR_PWM_GPIO_B
        int "PWM B GPIO"
        default 15
        help
            GPIO number for PWM B output.

    config BDC_MOTOR_PWM_FREQ_HZ
        int "PWM Frequency (Hz)"
        default 25000
        help
            PWM frequency in Hz.

    config BDC_MOTOR_ENCODER_GPIO_A
        int "Encoder A GPIO"
        default 14
        help
            GPIO number for Encoder phase A.

    config BDC_MOTOR_ENCODER_GPIO_B
        int "Encoder B GPIO"
        default 27
        help
            GPIO number for Encoder phase B.

    config BDC_MOTOR_PCNT_HIGH_LIMIT
        int "Encoder PCNT High Limit"
        default 1000
        help
            Maximum count value for the pulse counter before overflow/wrapping.

    config BDC_MOTOR_PCNT_LOW_LIMIT
        int "Encoder PCNT Low Limit"
        default -1000
        help
            Minimum count value for the pulse counter before underflow/wrapping.

    config BDC_MOTOR_ENCODER_RESOLUTION
        int "Encoder Resolution (PPR)"
        default 2400
        help
            The number of pulses per revolution of the encoder.

    config BDC_MOTOR_PID_LOOP_PERIOD_MS
        int "PID Loop Period (ms)"
        default 10
        help
            Period in milliseconds for the PID control loop calculation.

    config BDC_MOTOR_ENABLE_QUADRATURE_ENCODER
        bool "Enable Quadrature Encoder"
        default "y"
        help
            Enable quadrature encoder mode. If disabled, single channel counter mode is used.

    config BDC_MOTOR_SERIAL_STUDIO_DEBUG
        bool "Enable log for Serial Studio"
        default "n"
        help
            Enable this option to print debug logs that can be parsed by Serial Studio.

endmenu
```

## components/digital_input/Kconfig
```kconfig
menu "Digital Input Configuration"

    config DIGITAL_INPUT_PIN_HANDGUARD_RIGHT
        int "GPIO Pin for Handguard RIGHT"
        default 18
        help
            GPIO pin number connected to the right handguard switch (User Input).

    config DIGITAL_INPUT_PIN_HANDGUARD_LEFT
        int "GPIO Pin for Handguard LEFT"
        default 19
        help
            GPIO pin number connected to the left handguard switch (User Input).

    config DIGITAL_INPUT_PIN_RESET_BTN
        int "GPIO Pin for Reset Button"
        default 21
        help
            GPIO pin number connected to the Reset button (User Input).

    config DIGITAL_INPUT_PIN_LIGHTGATE_START
        int "GPIO Pin for Lightgate START"
        default 22
        help
            GPIO pin number connected to the lightgate (start) sensor output.

    config DIGITAL_INPUT_PIN_LIGHTGATE_END
        int "GPIO Pin for Lightgate END"
        default 23
        help
            GPIO pin number connected to the lightgate (end) sensor output.

    config DIGITAL_INPUT_PIN_EMERGENCY_BTN
        int "GPIO Pin for Emergency Button Monitor"
        default 5
        help
            GPIO pin number monitoring the state of the hardware emergency stop circuit.
            NOTE: This is for software status only, not safety cutoff!

    config DIGITAL_INPUT_PIN_INDUCTIVE_SWITCH
        int "GPIO Pin for Inductive Switch"
        default 34
        help
            GPIO pin number connected to the inductive switch input.
            Input-only pin (GPIO34-39 are input-only on ESP32).
            External pull-down resistor is used (not internal pull-up).

    config DIGITAL_INPUT_TASK_PRIORITY
        int "Digital Input Task Priority"
        default 10
        range 1 24
        help
            FreeRTOS priority for the input processing task.
            Higher number = higher priority. 
            Should be high enough to process inputs quickly, but not starve communication tasks.

    config DIGITAL_INPUT_TASK_STACK_SIZE
        int "Digital Input Task Stack Size"
        default 2048
        help
            Stack size in bytes for the input processing task.
            Adjust if you add heavy processing or large stack variables.

endmenu
```

## components/led_control/Kconfig
```kconfig
menu "LED Control Configuration"

    config LED_CONTROL_PIN
        int "GPIO pin for LED"
        default 4
        help
            GPIO pin number to which the LED is connected.

    config LED_BLINK_INTERVAL_MS
        int "Fast blink interval in milliseconds"
        default 500
        help
            Time interval for fast LED blinking in milliseconds.

    config LED_BLINK_SLOW_INTERVAL_MS
        int "Slow blink interval in milliseconds"
        default 1000
        help
            Time interval for slow LED blinking in milliseconds.

    config LED_TASK_PRIORITY
        int "FreeRTOS task priority"
        default 5
        help
            Priority of the LED control task.

    config LED_TASK_STACK_SIZE
        int "FreeRTOS task stack size"
        default 2048
        help
            Stack size for the LED control task.

endmenu
```

## components/position_control/Kconfig
```kconfig
menu "Position Control Configuration"

    config POS_CTRL_PULLEY_RADIUS_MM
        int "Initial Pulley/Spool Radius (mm)"
        default 10
        help
            The initial radius of the winding/spool or pulley.
            This value is used as the base for calculating the circumference and thereby the millimeters per revolution.

    config POS_CTRL_LAYER_THICKNESS_MM
        int "Layer/Cord Thickness (mm)"
        default 2
        help
            The thickness of the cord or material that wraps around the pulley.
            Useful for future calculations where the effective diameter increases with each revolution.

    config POS_CTRL_MAX_POSITION_MM
        int "Maximum Position Limit (Software Endstop) (mm)"
        default 2000
        help
            The maximum distance the axis/curtain is allowed to travel. Serves as a software limit
            to prevent the motor from tearing the mechanical structure.

    config POS_CTRL_MIN_POSITION_MM
        int "Minimum Position Limit (Software Endstop) (mm)"
        default 0
        help
            The minimum distance the axis/curtain is allowed to travel. Serves as a software limit
            to prevent the motor from driving backwards into the structure.

    config POS_CTRL_MAX_REVOLUTIONS
        int "Maximum Motor Revolutions Limit"
        default 1000
        help
            The maximum number of revolutions the motor is allowed to turn.
            Serves as a software limit for pure rotational commands.

    config POS_CTRL_MIN_REVOLUTIONS
        int "Minimum Motor Revolutions Limit"
        default 0
        help
            The minimum number of revolutions the motor is allowed to turn.

    config POS_CTRL_TOLERANCE_MM
        int "Position Target Deadband/Tolerance (mm)"
        default 5
        help
            The acceptable error margin to consider the target position reached. 
            This prevents the motor from continuously "hunting" or jittering around the target.

    config POS_CTRL_LOOP_PERIOD_MS
        int "Position Control Loop Period (ms)"
        default 100
        help
            The execution period of the position control task or timer loop.

endmenu
```

## components/servo_control/Kconfig
```kconfig
menu "Servo Control Configuration"

    config SERVO_PULSE_GPIO
        int "GPIO Pin for Servo PWM"
        default 27
        help
            GPIO pin number connected to the PWM signal line of the servo.

    config SERVO_MIN_PULSEWIDTH_US
        int "Minimum Pulse Width (us)"
        default 500
        help
            Minimum pulse width in microseconds (typically maps to minimum angle).
            Consult your servo datasheet.

    config SERVO_MAX_PULSEWIDTH_US
        int "Maximum Pulse Width (us)"
        default 2500
        help
            Maximum pulse width in microseconds (typically maps to maximum angle).
            Consult your servo datasheet.

    config SERVO_MIN_DEGREE
        int "Minimum Angle (Degree)"
        default -90
        help
            Minimum angle of the servo.

    config SERVO_MAX_DEGREE
        int "Maximum Angle (Degree)"
        default 90
        help
            Maximum angle of the servo.

endmenu
```
